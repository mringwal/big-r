## components/big_r_led/Kconfig
```kconfig
menu "BIG-R LEDs"
    config BIG_R_LED_GPIO
        int "WS2812 data GPIO"
        range 0 48
        default 0
    config BIG_R_LED_COUNT
        int "Number of physical WS2812 LEDs"
        range 573 4096
        default 573
        help
            The original mapping addresses LED indices 0 through 572.
    config BIG_R_FRAME_MS
        int "Animation frame delay (ms)"
        range 20 1000
        default 20
endmenu
```

## main/Kconfig.projbuild
```kconfig
menu "BIG-R application"
    config BIG_R_BUTTON_GPIO
        int "Active-low animation button GPIO (-1 disables)"
        range -1 48
        default 10
        help
            GPIO10 is the installed active-low BIG-R animation button, verified by RAM monitoring.
    config ENABLE_MEMORY_PROFILING
        bool "Enable memory profiling"
        default n
endmenu
```
