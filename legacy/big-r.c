/* RMT example -- RGB LED Strip

   This example code is in the Public Domain (or CC0 licensed, at your option.)

   Unless required by applicable law or agreed to in writing, this
   software is distributed on an "AS IS" BASIS, WITHOUT WARRANTIES OR
   CONDITIONS OF ANY KIND, either express or implied.
*/
#include "sdkconfig.h"
#include "freertos/FreeRTOS.h"
#include "freertos/task.h"
#include "esp_log.h"
#include "driver/rmt.h"
#include "led_strip.h"
#include <string.h>

static const char *TAG = "example";

#define RMT_TX_CHANNEL RMT_CHANNEL_0

#define EXAMPLE_CHASE_SPEED_MS (10)

led_strip_t *strip;

typedef struct {
    uint8_t  x;
    uint8_t  y;
    uint16_t pos;
} led_position_t;

typedef struct {
    led_position_t start;
    led_position_t end; 
} led_segment_t;

static led_segment_t segments[] = {
    {{ 0, 0, 464 }, { 10, 0, 393}},
    {{ 1, 1, 480 }, {  4, 1, 504}}, {{7, 1, 353}, {11, 1, 378}},
    {{ 1, 2, 537 }, {  4, 2, 514}}, {{7, 2, 342}, {11, 2, 317}},
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    {{ 0, 7,  48 }, {  5, 6,   0}}, {{6, 7, 250}, {12, 7, 282}}
};

typedef struct {
    uint16_t led_id;
    uint16_t matrix_index;
} led_to_matrix_t;

static const led_to_matrix_t led_to_matrix[] = {
 {  464,    0 }, {  463,    0 }, {  462,    0 }, {  461,    1 }, {  460,    1 }, {  459,    1 }, {  458,    2 }, {  457,    2 },
 {  456,    2 }, {  455,    3 }, {  454,    3 }, {  453,    3 }, {  452,    4 }, {  451,    4 }, {  450,    4 }, {  449,    5 },
 {  448,    5 }, {  447,    5 }, {  446,    6 }, {  445,    6 }, {  444,    6 }, {  443,    7 }, {  442,    7 }, {  441,    7 },
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 {  277,  922 }, {  278,  923 }, {  279,  923 }, {  280,  924 }, {  281,  924 }, {  282,  925 }};

static uint16_t num_leds = sizeof(led_to_matrix) / sizeof(led_to_matrix_t);

static const uint16_t pattern_rainbow_left_to_right[] = {
   0,  11,  22,  33,  45,  56,  67,  78,  90, 101, 112, 123, 135, 146, 157, 168, 180, 191, 202, 213, 225, 236, 247, 258, 270, 281, 292, 303, 315, 326, 337, 348,
   0,  11,  22,  33,  45,  56,  67,  78,  90, 101, 112, 123, 135, 146, 157, 168, 180, 191, 202, 213, 225, 236, 247, 258, 270, 281, 292, 303, 315, 326, 337, 348,
   0,  11,  22,  33,  45,  56,  67,  78,  90, 101, 112, 123, 135, 146, 157, 168, 180, 191, 202, 213, 225, 236, 247, 258, 270, 281, 292, 303, 315, 326, 337, 348,
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   0,  11,  22,  33,  45,  56,  67,  78,  90, 101, 112, 123, 135, 146, 157, 168, 180, 191, 202, 213, 225, 236, 247, 258, 270, 281, 292, 303, 315, 326, 337, 348,
};

static const uint16_t pattern_rainbow_top_to_bottom[] = {
   0,   0,   0,   0,   0,   0,   0,   0,   0,   0,   0,   0,   0,   0,   0,   0,   0,   0,   0,   0,   0,   0,   0,   0,   0,   0,   0,   0,   0,   0,   0,   0,
  11,  11,  11,  11,  11,  11,  11,  11,  11,  11,  11,  11,  11,  11,  11,  11,  11,  11,  11,  11,  11,  11,  11,  11,  11,  11,  11,  11,  11,  11,  11,  11,
  22,  22,  22,  22,  22,  22,  22,  22,  22,  22,  22,  22,  22,  22,  22,  22,  22,  22,  22,  22,  22,  22,  22,  22,  22,  22,  22,  22,  22,  22,  22,  22,
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 348, 348, 348, 348, 348, 348, 348, 348, 348, 348, 348, 348, 348, 348, 348, 348, 348, 348, 348, 348, 348, 348, 348, 348, 348, 348, 348, 348, 348, 348, 348, 348,
};

static const uint16_t pattern_rainbow_circle_quadrant[] = {
 270,   0,   0,   0,   0,   0,   0,   0,   0,   0,   0,   0,   0,   0,   0,   0,   0,   0,   0,   0,   0,   0,   0,   0,   0,   0,   0,   0,   0,   0,   0,   0,
  90,  45,  26,  18,  14,  11,   9,   8,   7,   6,   5,   5,   4,   4,   4,   3,   3,   3,   3,   3,   2,   2,   2,   2,   2,   2,   2,   2,   2,   1,   1,   1,
  90,  63,  45,  33,  26,  21,  18,  15,  14,  12,  11,  10,   9,   8,   8,   7,   7,   6,   6,   6,   5,   5,   5,   4,   4,   4,   4,   4,   4,   3,   3,   3,
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  90,  88,  86,  84,  82,  80,  79,  77,  75,  73,  72,  70,  68,  67,  65,  64,  62,  61,  59,  58,  57,  55,  54,  53,  52,  51,  50,  48,  47,  46,  45,  45,
};

static const uint16_t pattern_rainbow_circle_centered[] = {
 216, 218, 220, 222, 225, 227, 230, 233, 236, 239, 243, 247, 251, 255, 260, 265, 270, 274, 279, 284, 288, 292, 296, 300, 303, 306, 309, 312, 315, 317, 319, 321,
 214, 216, 218, 220, 222, 225, 227, 230, 233, 237, 241, 245, 250, 254, 259, 264, 270, 275, 280, 285, 289, 294, 298, 302, 306, 309, 312, 315, 317, 319, 321, 323,
 212, 213, 215, 217, 219, 222, 225, 228, 231, 235, 239, 243, 248, 253, 258, 264, 270, 275, 281, 286, 291, 296, 300, 304, 308, 311, 315, 317, 320, 322, 324, 326,
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 130, 128, 126, 124, 122, 120, 117, 115, 112, 110, 107, 104, 101,  98,  96,  93,  90,  86,  83,  81,  78,  75,  72,  69,  67,  64,  62,  59,  57,  55,  53,  51,
};

static const uint16_t * patterns[] = {
    pattern_rainbow_left_to_right,
    pattern_rainbow_top_to_bottom,
    pattern_rainbow_circle_quadrant,
    pattern_rainbow_circle_centered
};

typedef struct {
    uint8_t r;
    uint8_t g;
    uint8_t b;
} rgb_t;

static rgb_t hue_to_rgb[360];

static uint8_t map[CONFIG_EXAMPLE_STRIP_LED_NUMBER];

static void setup_map(void){
    uint8_t num_segments = sizeof(segments) / sizeof(led_segment_t);
    memset(map, 0, sizeof(map));
    int i;
    uint16_t start;
    uint16_t end;
    for (i=0;i<num_segments;i++){
        if (segments[i].start.pos < segments[i].end.pos){
            start = segments[i].start.pos;
            end   = segments[i].end.pos;
        } else {
            start = segments[i].end.pos;
            end   = segments[i].start.pos;
        }
        memset(&map[start], 0xff, end - start + 1);
    }
}

/**
 * @brief Simple helper function, converting HSV color space to RGB color space
 *
 * Wiki: https://en.wikipedia.org/wiki/HSL_and_HSV
 *
 */
static void led_strip_hsv2rgb(uint32_t h, uint32_t s, uint32_t v, uint32_t *r, uint32_t *g, uint32_t *b)
{
    h %= 360; // h -> [0,360]
    uint32_t rgb_max = v * 2.55f;
    uint32_t rgb_min = rgb_max * (100 - s) / 100.0f;

    uint32_t i = h / 60;
    uint32_t diff = h % 60;

    // RGB adjustment amount by hue
    uint32_t rgb_adj = (rgb_max - rgb_min) * diff / 60;

    switch (i) {
    case 0:
        *r = rgb_max;
        *g = rgb_min + rgb_adj;
        *b = rgb_min;
        break;
    case 1:
        *r = rgb_max - rgb_adj;
        *g = rgb_max;
        *b = rgb_min;
        break;
    case 2:
        *r = rgb_min;
        *g = rgb_max;
        *b = rgb_min + rgb_adj;
        break;
    case 3:
        *r = rgb_min;
        *g = rgb_max - rgb_adj;
        *b = rgb_max;
        break;
    case 4:
        *r = rgb_min + rgb_adj;
        *g = rgb_min;
        *b = rgb_max;
        break;
    default:
        *r = rgb_max;
        *g = rgb_min;
        *b = rgb_max - rgb_adj;
        break;
    }
}

static void setup_hue_to_rgb(uint8_t brightness){
    uint16_t hue;
    uint32_t red = 0;
    uint32_t green = 0;
    uint32_t blue = 0;
    for (hue=0;hue<360;hue++){
        led_strip_hsv2rgb(hue, 100, 100, &red, &green, &blue);
        hue_to_rgb[hue].r = red;
        hue_to_rgb[hue].g = green;
        hue_to_rgb[hue].b = blue;
    }    
}

static void led_strip_pattern(const uint16_t * pattern, uint16_t start){
    uint16_t i;
    for (i = 0; i < num_leds; i++) {
        const led_to_matrix_t * entry = &led_to_matrix[i]; 
        uint16_t hue = (pattern[entry->matrix_index] + start) % 360;
        ESP_ERROR_CHECK(strip->set_pixel(strip, entry->led_id, hue_to_rgb[hue].r, hue_to_rgb[hue].g, hue_to_rgb[hue].b));
    }
}

void app_main(void)
{
    rmt_config_t config = RMT_DEFAULT_CONFIG_TX(CONFIG_EXAMPLE_RMT_TX_GPIO, RMT_TX_CHANNEL);
    // set counter clock to 40MHz
    config.clk_div = 2;

    ESP_ERROR_CHECK(rmt_config(&config));
    ESP_ERROR_CHECK(rmt_driver_install(config.channel, 0, 0));

    // install ws2812 driver
    led_strip_config_t strip_config = LED_STRIP_DEFAULT_CONFIG(CONFIG_EXAMPLE_STRIP_LED_NUMBER, (led_strip_dev_t)config.channel);
    strip = led_strip_new_rmt_ws2812(&strip_config);
    if (!strip) {
        ESP_LOGE(TAG, "install WS2812 driver failed");
    }
    // Clear LED strip (turn off all LEDs)
    ESP_ERROR_CHECK(strip->clear(strip, 100));
    // Show simple rainbow chasing pattern
    ESP_LOGI(TAG, "LED Rainbow Chase Start");

    setup_map();

    int pattern = 3;
    uint16_t start = 0;
    uint16_t brightness = 40;
    setup_hue_to_rgb(brightness);
    while(1) {
        int ch = fgetc(stdin);
        if (ch > 0){
            switch (ch){
            case 1:
            case 2:
            case 3:
            case 4:
                pattern = ch - '1';
                printf("Pattern: %u\n", pattern);
                break;
            case '+':
                brightness += 10;
                if (brightness >= 100){
                    brightness = 100;
                }
                setup_hue_to_rgb(brightness);
                break;
            case '-':
                if (brightness < 0x10){
                    brightness = 0;
                } 
                brightness -= 10;
                setup_hue_to_rgb(brightness);
                break;
            default:
                break;
            }
        }
        led_strip_pattern(patterns[pattern], start);
        ESP_ERROR_CHECK(strip->refresh(strip, 100));
        start = (start + 1) % 360;
        vTaskDelay(pdMS_TO_TICKS(10));
    }
}

